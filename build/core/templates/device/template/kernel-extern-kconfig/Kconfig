## build/core/templates/device/template/kernel-extern-kconfig/Kconfig
```kconfig
menu "external driver"
choice
	prompt "Ext Board Name"
	default DT_Template

config DT_Template
	bool "template board."

endchoice
endmenu
```
